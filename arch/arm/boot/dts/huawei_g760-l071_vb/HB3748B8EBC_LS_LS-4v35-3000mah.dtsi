/* Copyright (c) 2013, The Linux Foundation. All rights reserved.
 *
 * This program is free software; you can redistribute it and/or modify
 * it under the terms of the GNU General Public License version 2 and
 * only version 2 as published by the Free Software Foundation.
 *
 * This program is distributed in the hope that it will be useful,
 * but WITHOUT ANY WARRANTY; without even the implied warranty of
 * MERCHANTABILITY or FITNESS FOR A PARTICULAR PURPOSE.  See the
 * GNU General Public License for more details.
 */

qcom,qrd-4v35-3000mAh-lishen-data {
	qcom,fcc-mah = <3000>;
	qcom,default-rbatt-mohm = <130>;
	qcom,rbatt-capacitive-mohm = <0>;
	qcom,flat-ocv-threshold-uv = <3800000>;
	qcom,max-voltage-uv = <4350000>;
	qcom,v-cutoff-uv = <3400000>;
	qcom,chg-term-ua = <100000>;
	qcom,batt-id-kohm = <39>;
	qcom,batt-name = "HB3748B8EBC_LS_LS";

	qcom,warm-bat-decidegc = <420>;
	qcom,warm-bat-mv = <4100>;
	qcom,ibatmax-warm-ma = <800>;

	qcom,cool-bat-decidegc = <100>;
	qcom,cool-bat-mv = <4350>;
	qcom,ibatmax-cool-ma = <900>;

	qcom,hot-bat-decidegc = <520>;
	qcom,cold-bat-decidegc = <0>;

	qcom,rbatt-sf-lut {
		qcom,lut-col-legend = <(-20) 0 25 40 60>;
		qcom,lut-row-legend = <100 95 90 85 80>,
				<75 70 65 60 55>,
				<50 45 40 35 30>,
				<25 20 16 13 11>,
				<10 9 8 7 6>,
				<5 4 3 2 1>,
				<0>;
		qcom,lut-data = <1336 318 100 76 70>,
				<1333 318 100 77 70>,
				<1204 303 103 79 71>,
				<1152 299 106 81 73>,
				<1093 288 111 84 75>,
				<1022 291 118 90 78>,
				<1012 273 121 92 80>,
				<1000 280 126 98 84>,
				<1004 278 107 96 86>,
				<1018 276 98 78 72>,
				<1039 277 98 78 72>,
				<1064 280 100 80 74>,
				<1090 283 103 83 76>,
				<1123 290 106 85 80>,
				<1163 296 107 84 78>,
				<1213 305 106 82 73>,
				<1305 325 106 81 73>,
				<1485 351 103 82 74>,
				<1556 369 96 77 71>,
				<1637 351 98 78 72>,
				<1783 358 100 80 74>,
				<1952 369 103 83 76>,
				<2151 382 108 86 77>,
				<2432 396 112 88 80>,
				<2815 410 115 89 79>,
				<3357 432 111 84 74>,
				<4150 469 107 82 74>,
				<5440 536 110 85 76>,
				<8068 683 120 90 80>,
				<20073 9123 250 134 113>,
				<88946 62515 39806 30169 4316>;
	};

	qcom,fcc-temp-lut {
		qcom,lut-col-legend = <(-20) 0 25 40 60>;
		qcom,lut-data = <3082 3070 3069 3070 3061>;
	};

	qcom,pc-temp-ocv-lut {
		qcom,lut-col-legend = <(-20) 0 25 40 60>;
		qcom,lut-row-legend = <100 95 90 85 80>,
				<75 70 65 60 55>,
				<50 45 40 35 30>,
				<25 20 16 13 11>,
				<10 9 8 7 6>,
				<5 4 3 2 1>,
				<0>;
		qcom,lut-data = <4340 4329 4323 4321 4317>,
				<4224 4255 4258 4258 4254>,
				<4146 4198 4202 4202 4198>,
				<4095 4141 4148 4148 4144>,
				<4037 4083 4096 4096 4093>,
				<3955 4033 4053 4048 4044>,
				<3911 3955 3989 3996 3999>,
				<3871 3919 3955 3960 3958>,
				<3839 3889 3904 3915 3915>,
				<3816 3857 3864 3866 3866>,
				<3797 3829 3836 3837 3837>,
				<3780 3804 3814 3814 3814>,
				<3764 3784 3795 3795 3795>,
				<3748 3768 3780 3779 3779>,
				<3732 3753 3767 3764 3759>,
				<3716 3737 3754 3748 3735>,
				<3697 3723 3735 3728 3714>,
				<3678 3712 3710 3704 3691>,
				<3659 3704 3691 3683 3672>,
				<3645 3696 3688 3681 3669>,
				<3635 3692 3688 3680 3669>,
				<3624 3688 3686 3679 3668>,
				<3610 3681 3685 3678 3666>,
				<3592 3671 3681 3675 3663>,
				<3571 3653 3672 3666 3653>,
				<3543 3622 3646 3639 3621>,
				<3505 3575 3599 3592 3573>,
				<3451 3508 3535 3529 3512>,
				<3365 3409 3446 3443 3428>,
				<3235 3268 3310 3309 3301>,
				<3000 3000 3000 3000 3000>;
	};
};
